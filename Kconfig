## Kconfig
```kconfig
config CUSTOM_WIDGET_STATUS
    bool "Enable custom status screen"
    depends on ZMK_DISPLAY
    select LVGL
    select LVGL_USE_LABEL
    select LVGL_USE_IMG
```

## boards/shields/mb_oled/Kconfig.defconfig
```kconfig
if SHIELD_MB_OLED

config CUSTOM_WIDGET_STATUS
    bool "Enable custom status screen"
    default y
    select LV_USE_LABEL
    select LV_USE_IMAGE
    select LV_USE_CANVAS
    select LV_USE_ANIMIMG 
    select LV_USE_ANIMATION
    select LV_USE_LINE 
    select LV_FONT_UNSCII_8
    select ZMK_WPM
    imply ZMK_HID_INDICATORS

config LV_Z_MEM_POOL_SIZE
    default 8192

config LV_Z_VDB_SIZE
    default 64

config LV_DPI_DEF
    default 148

config LV_Z_BITS_PER_PIXEL
    default 1

choice LV_COLOR_DEPTH
    default LV_COLOR_DEPTH_1
endchoice

endif
```
